## conf/distro/g8row.conf
```bitbake
#include conf/distro/include/default-providers.inc
#include conf/distro/include/default-versions.inc
#include conf/distro/include/default-distrovars.inc
#include conf/distro/include/maintainers.inc

#require conf/distro/include/tcmode-${TCMODE}.inc
#require conf/distro/include/tclibc-${TCLIBC}.inc

#require conf/distro/include/uninative-flags.inc

DISTRO = "g8row"
DISTRO_NAME = "g8row distro"

TCLIBC = "glibc"

# Allow single libc distros to disable this code
#TCLIBCAPPEND ?= "-${TCLIBC}"
#TMPDIR .= "${TCLIBCAPPEND}"

G8ROW_DEFAULT_DISTRO_FEATURES = "largefile ptest multiarch"
G8ROW_DEFAULT_EXTRA_RDEPENDS = "packagegroup-core-boot"
G8ROW_DEFAULT_EXTRA_RRECOMMENDS = "kernel-module-af-packet"

#VIRTUAL-RUNTIME_init_manager = "systemd"
#DISTRO_FEATURES_BACKFILL_CONSIDERED = "sysvinit"
#VIRTUAL-RUNTIME_initscripts = ""
INIT_MANAGER = "systemd"
RPI_USE_U_BOOT = "1"

DISTRO_FEATURES ?= "${DISTRO_FEATURES_DEFAULT} ${G8ROW_DEFAULT_DISTRO_FEATURES}"
DISTRO_EXTRA_RDEPENDS += "${G8ROW_DISTRO_EXTRA_RDEPENDS}"
DISTRO_EXTRA_RRECOMMENDS += "${G8ROW_DISTRO_EXTRA_RRECOMMENDS}"
#USER_CLASSES ?= ""
#PACKAGE_CLASSES ?= "package_ipk"
#INHERIT_DISTRO ?= "debian devshell sstate license remove-libtool"
#INHERIT += "${PACKAGE_CLASSES} ${USER_CLASSES} ${INHERIT_DISTRO}"

#require conf/distro/include/init-manager-${INIT_MANAGER}.inc
require conf/distro/include/no-static-libs.inc
require conf/distro/include/yocto-uninative.inc
INHERIT += "uninative"
```

## conf/layer.conf
```bitbake
BBPATH .= ":${LAYERDIR}"


BBFILES += "${LAYERDIR}/recipes-*/*/*.bb \
            ${LAYERDIR}/recipes-*/*/*.bbappend"

BBFILE_COLLECTIONS += "g8row"
BBFILE_PATTERN_g8row = "^${LAYERDIR}/"
BBFILE_PRIORITY_g8row = "99"
LAYERVERSION_g8row = "0"
LAYERSERIES_COMPAT_g8row = "kirkstone"
```
